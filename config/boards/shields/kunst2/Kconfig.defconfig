## config/boards/shields/kunst2/Kconfig.defconfig
```kconfig
# Copyright (c) 2020 The ZMK Contributors
# SPDX-License-Identifier: MIT

config ZMK_BLE
	default y

config ZMK_USB
	default y

if SHIELD_KUNST2_DONGLE || SHIELD_KUNST2_NORM_LEFT || SHIELD_KUNST2_NORM_RIGHT

config ZMK_KEYBOARD_NAME
	default "The Kunst v.2"

endif

if SHIELD_KUNST2_DONGLE_LEFT || SHIELD_KUNST2_DONGLE_RIGHT || SHIELD_KUNST2_NORM_RIGHT

config ZMK_SPLIT
	default y

endif

if SHIELD_KUNST2_DONGLE || SHIELD_KUNST2_NORM_LEFT

config ZMK_SPLIT
	default y

config ZMK_SPLIT_BLE_ROLE_CENTRAL
	default y

endif
```

## config/boards/shields/kunst2/Kconfig.shield
```kconfig
# Copyright (c) 2020 The ZMK Contributors
# SPDX-License-Identifier: MIT

config SHIELD_KUNST_NORM_LEFT
	def_bool $(shields_list_contains,kunst2_norm_left)

config SHIELD_KUNST_NORM_RIGHT
	def_bool $(shields_list_contains,kunst2_norm_right)
```
